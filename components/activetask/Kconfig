## components/activetask/Kconfig
```kconfig
menu "Active Task"
    menu "Kernel"
        config FreeRTOS
            int "using FreeRTOS"
            default 1
        config MSG_BLK_NUM
            int "number of message block"
            default 8
        config DATA_BLK_NUM
            int "number of data block"
            default 8
        config DATA_BLK_MIN
            int "minimal size of data block"
            default 64
        config DATA_BLK_STACK
            int "number of data block stack"
            default 3
    endmenu
endmenu
```

## components/network/Kconfig
```kconfig
menu "Network"
    menu "Provisioning"
        config PROV_SOFTAP
            int "provisioning WiFi using SoftAP"
            default 1
        config PROV_BLE
            int "provisioning WiFi using BLE"
            default 1
        # TODO security
    endmenu
    menu "Protocol Layer"
        config N2N_UDP_PORT
            int "UDP port for N2N protocol"
            default 3999
        choice MCAST_IP_MODE
            prompt "Receive Multicast IP type"
            help
                Example can receive multicast IPV4, IPV6, both or none.

            config MCAST_NONE
                bool "None"

            config MCAST_IPV4_V6
                bool "IPV4 & IPV6"
                select MCAST_IPV4
                select MCAST_IPV6

            config MCAST_IPV4_ONLY
                bool "IPV4"

            config MCAST_IPV6_ONLY
                bool "IPV6"
        endchoice

        config MCAST_IPV4
            bool
        config MCAST_IPV6
            bool

        config MULTICAST_IPV4_ADDR
            string "Multicast IPV4 Address (receive)"
            default "239.0.1.187"
            depends on MCAST_IPV4
            help
                IPV4 multicast address to receive multicast traffic on.

                The default IPV4 address is 224.0.1.187.

        config MULTICAST_IPV6_ADDR
            string "Multicast IPV6 Address (receive)"
            default "FF02::FD"
            depends on MCAST_IPV6
            help
                IPV6 multicast address to receive multicast traffic on.

                The default FF02::FD address is a link-local multicast address.
                Consult IPV6 specifications or documentation for information about
                meaning of different IPV6 multicast ranges.
    endmenu
endmenu
```
